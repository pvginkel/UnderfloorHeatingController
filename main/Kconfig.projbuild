## main/Kconfig.projbuild
```kconfig
menu "Device Configuration"

    orsource "$IDF_PATH/examples/common_components/env_caps/$IDF_TARGET/Kconfig.env_caps"

    config DEVICE_CONFIG_ENDPOINT
        string "Device config endpoint (%s becomes MAC address)"

    config DEVICE_CURRENT_MONITOR_PIN
        int "Current monitor pin"
        default -1

    config DEVICE_MOTOR_RELAY_PIN
        int "Motor relay pin"
        default -1

    config DEVICE_ETA_1_PIN
        int "ETA 1 pin"
        default -1

    config DEVICE_ETA_2_PIN
        int "ETA 2 pin"
        default -1

    config DEVICE_ETA_3_PIN
        int "ETA 3 pin"
        default -1

    config DEVICE_ETA_4_PIN
        int "ETA 4 pin"
        default -1

    config DEVICE_ETA_5_PIN
        int "ETA 5 pin"
        default -1

    config DEVICE_ETA_6_PIN
        int "ETA 6 pin"
        default -1

    config DEVICE_ETA_7_PIN
        int "ETA 7 pin"
        default -1

    config DEVICE_ETA_8_PIN
        int "ETA 8 pin"
        default -1

    config DEVICE_ETA_9_PIN
        int "ETA 9 pin"
        default -1

    config DEVICE_ETA_10_PIN
        int "ETA 10 pin"
        default -1

    config DEVICE_ETA_11_PIN
        int "ETA 11 pin"
        default -1

    config DEVICE_ETA_12_PIN
        int "ETA 12 pin"
        default -1

    config DEVICE_CURRENT_METER_REPORT_INTERVAL_MS
        int "Current meter report interval in ms"
        default 10000

endmenu
```

## sdkconfig.defaults
```kconfig
# Application configuration

CONFIG_DEVICE_CURRENT_MONITOR_PIN=1
CONFIG_DEVICE_MOTOR_RELAY_PIN=2
CONFIG_DEVICE_ETA_1_PIN=8
CONFIG_DEVICE_ETA_2_PIN=7
CONFIG_DEVICE_ETA_3_PIN=6
CONFIG_DEVICE_ETA_4_PIN=5
CONFIG_DEVICE_ETA_5_PIN=4
CONFIG_DEVICE_ETA_6_PIN=3
CONFIG_DEVICE_ETA_7_PIN=9
CONFIG_DEVICE_ETA_8_PIN=10
CONFIG_DEVICE_ETA_9_PIN=11
CONFIG_DEVICE_ETA_10_PIN=12
CONFIG_DEVICE_ETA_11_PIN=13
CONFIG_DEVICE_ETA_12_PIN=14

# Setup flash

CONFIG_ESPTOOLPY_FLASHSIZE_4MB=y
CONFIG_PARTITION_TABLE_CUSTOM=y

# SPIRAM

CONFIG_SPIRAM=y
CONFIG_SPIRAM_FETCH_INSTRUCTIONS=y
CONFIG_SPIRAM_RODATA=y
CONFIG_SPIRAM_SPEED_80M=y

# Status led

CONFIG_STATUS_LED_WS2812_PIN=38

# MQTT

CONFIG_MQTT_TOPIC_PREFIX="underfloor_heating_controller"
CONFIG_MQTT_DEVICE_MANUFACTURER="Pieter"
CONFIG_MQTT_DEVICE_MODEL="Underfloor Heating Controller"
CONFIG_MQTT_DEVICE_MODEL_ID="Underfloor Heating Controller v1"
```
